#include "beep.h"


uchar u=0;

uint x=0;//休止符或结束符计时变量
uchar m=0;//频率常数变量
uchar n=0;//节拍常数变量


 //格式为: 频率常数,节拍常数
uchar code beep_4[]=
{
	0x01,0x10,
	0xff,
	0x01,0x10,
	0xff,0xff,
	0x01,0x10,
	0xff,
	0x01,0x10,
	0x00
};

uchar *w=beep_4;


/************************************************************/
void Timer2Init()//（定时器T2）初始化
{
	T2CON=0x00; //配置定时器T2工作在16位自动重装载模式
	RCAP2H=TH2=0xfc; //给定时器T2赋初值和重装载值，定时1ms（11.0592MHz）
	RCAP2L=TL2=0x66;
	ET2=1; //打开定时器T2中断允许
	EA=1; //打开总中断
//	TR2=1; //打开定时器T2
}


/************************************************************/
void Timer2() interrupt 5
{
	TF2=0; //清零T2中断标志  //与定时器T0、T1不同，必须软件清零

	u++; //每中断一次(每1ms)，加一次

	if( (*w)!=0x00 ) //确定不是结束符才工作
		{
			if( (*w)==0xFF ) //若是休止符则延时100ms并继续下一音符
				{
					x++;//每中断一次(每1ms)，加一次
					if(x==50) {x=0;u=0;w++;}//让u也复位是为了后面mn自增相对准确一点
				}
			else
				{
					m++; //m每1ms加一次
					if(u%10==0)n++; //n每10ms加一次
					
					if( n<=*(w+1) )
						{
							if( m>=(*w) )
								{
									m=0;
									buzzer=~buzzer;
								}
						}
					else
						{
							n=0;
							m=0;
							u=0;//让u也复位，为下面的音符做准备
							w+=2;
						}
				}
		}
	else //若是结束符则延时1000ms并从头开始	if( (*w)==0x00 )
		{
			x++;//每中断一次(每1ms)，加一次
			if(x==1000) {x=0;u=0;w=beep_4;}//让u也复位，为下面的音符做准备
		}
		
	if(u==30) u=0;

}
