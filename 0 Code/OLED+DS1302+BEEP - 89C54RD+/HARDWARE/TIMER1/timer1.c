#include "timer1.h"


bit k_f=0;
bit k_s=0;
bit fq=1;  //接收k_f或k_s的值---控制*P指中的或整个的数码管的闪烁频率


/************************************************************/
void Timer1Init()//（定时器1）初始化
{
	TMOD|=0x10; //选择为定时器1模式，工作方式1，仅用TR1打开启动
	TH1=0x4c; //给定时器1赋初值，定时50ms（11.0592MHz）
	TL1=0x00;
	ET1=1; //打开定时器1中断允许
	EA=1; //打开总中断
	TR1=1; //打开定时器1	
}


/************************************************************/
void Timer1() interrupt 3
{
	static uchar k=0;
	TH1=0x4c; //重装载
	TL1=0x00;
	k++; //每中断一次(每50ms)，加一次

	//让k_f、k_s取反频率不同，得到两种闪烁频率
	if(k%5==0)  {k_f=~k_f;}//5*50ms=250ms--0.25s变一次
	if(k%10==0) {k_s=~k_s;}//10*50ms=500ms--0.5s变一次

	//在修改页面的位选择时选中数码管慢闪，在进入位修改后选中数码管快闪，在闹钟触发时全部数码管快闪
	if( (KeyValue_plus=='E') || (ring_bit==1) ) //快闪
			fq=k_f;
	else //慢闪
			fq=k_s;
	
	if( (KL==0) || (KR==0) ) //保证长按左右按键时-变量q所代表的数据-不为空白
		  fq=1;
		
	if(k==20)//周期20*50ms=1s 
		{
			k=0;
		}
		
}
